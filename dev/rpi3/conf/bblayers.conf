## dev/rpi3/conf/bblayers.conf
```bitbake
# POKY_BBLAYERS_CONF_VERSION is increased each time build/conf/bblayers.conf
# changes incompatibly
POKY_BBLAYERS_CONF_VERSION = "2"

BBPATH = "${TOPDIR}"
BBFILES ?= ""

BBLAYERS ?= " \
  /workdir/dev/meta \
  /workdir/dev/meta-poky \
  /workdir/dev/meta-yocto-bsp \
  /workdir/dev/meta-openembedded/meta-oe \
  /workdir/dev/meta-openembedded/meta-python \
  /workdir/dev/meta-openembedded/meta-networking \
  /workdir/dev/meta-openembedded/meta-webserver \
  /workdir/dev/meta-raspberrypi \
  /workdir/dev/meta-navdatanet \
  "
```

## dev/rpi3/conf/local.conf
```bitbake
MACHINE ?= "raspberrypi3-64"
GPU_MEM = "16"
ENABLE_UART = "1"
MACHINE_FEATURES += " pi3-disable-bt"

#
# Machine Selection
#
# You need to select a specific machine to target the build with. There are a selection
# of emulated machines available which can boot and run in the QEMU emulator:
#
#MACHINE ?= "qemuarm"
#MACHINE ?= "qemuarm64"
#MACHINE ?= "qemumips"
#MACHINE ?= "qemumips64"
#MACHINE ?= "qemuppc"
#MACHINE ?= "qemux86"
#MACHINE ?= "qemux86-64"
#
# There are also the following hardware board target machines included for 
# demonstration purposes:
#
#MACHINE ?= "beaglebone"
#MACHINE ?= "genericx86"
#MACHINE ?= "genericx86-64"
#MACHINE ?= "mpc8315e-rdb"
#MACHINE ?= "edgerouter"
#
# This sets the default machine to be qemux86 if no other machine is selected:
MACHINE ??= "qemux86"

DL_DIR = "/workdir/download"
DISTRO ?= "poky"
PACKAGE_CLASSES ?= "package_ipk"
EXTRA_IMAGE_FEATURES ?= "debug-tweaks"
# NOTE: mklibs also needs to be explicitly enabled for a given image, see local.conf.extended
USER_CLASSES ?= "buildstats image-mklibs image-prelink"
PATCHRESOLVE = "noop"

BB_DISKMON_DIRS = "\
    STOPTASKS,${TMPDIR},1G,100K \
    STOPTASKS,${DL_DIR},1G,100K \
    STOPTASKS,${SSTATE_DIR},1G,100K \
    STOPTASKS,/tmp,100M,100K \
    ABORT,${TMPDIR},100M,1K \
    ABORT,${DL_DIR},100M,1K \
    ABORT,${SSTATE_DIR},100M,1K \
    ABORT,/tmp,10M,1K"

PACKAGECONFIG_append_pn-qemu-native = " sdl"
PACKAGECONFIG_append_pn-nativesdk-qemu = " sdl"
CONF_VERSION = "1"

#IMAGE_FEATURES += " package-management"

#PACKAGE_FEED_URIS = "http://ipk.navdata.net"
#PACKAGE_FEED_BASE_PATHS = "dev"
#PACKAGE_FEED_ARCHS = "aarch64 noarch raspberrypi3_64"

#IMAGE_INSTALL_append += " ntp"
#IMAGE_INSTALL_append += " rpi-config"

#DISTRO_FEATURES_append = " systemd"
#DISTRO_FEATURES_BACKFILL_CONSIDERED += " sysvinit"
#VIRTUAL-RUNTIME_init_manager = "systemd"
#VIRTUAL-RUNTIME_initscripts = "systemd-compat-units"
```

## prod/rpi3/conf/bblayers.conf
```bitbake
# POKY_BBLAYERS_CONF_VERSION is increased each time build/conf/bblayers.conf
# changes incompatibly
POKY_BBLAYERS_CONF_VERSION = "2"

BBPATH = "${TOPDIR}"
BBFILES ?= ""

BBLAYERS ?= " \
  /workdir/prod/meta \
  /workdir/prod/meta-poky \
  /workdir/prod/meta-yocto-bsp \
  /workdir/prod/meta-openembedded/meta-oe \
  /workdir/prod/meta-openembedded/meta-python \
  /workdir/prod/meta-openembedded/meta-networking \
  /workdir/prod/meta-openembedded/meta-webserver \
  /workdir/prod/meta-raspberrypi \
  /workdir/prod/meta-navdatanet \
  "
```
